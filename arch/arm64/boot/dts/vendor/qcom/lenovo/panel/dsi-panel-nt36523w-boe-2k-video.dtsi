&mdss_mdp {
	dsi_nt36523w_2k_vid: qcom,mdss_dsi_nt36523w_boe_2k_video {
		qcom,mdss-dsi-panel-name = "Novatek36523W video mode dsi boe panel";
		qcom,mdss-dsi-panel-type = "dsi_video_mode";
		qcom,dsi-ctrl-num = <0>;
		qcom,dsi-phy-num = <0>;
		qcom,mdss-dsi-virtual-channel-id = <0>;
		qcom,mdss-dsi-stream = <0>;
		qcom,mdss-dsi-h-left-border = <0>;
		qcom,mdss-dsi-h-right-border = <0>;
		qcom,mdss-dsi-v-top-border = <0>;
		qcom,mdss-dsi-v-bottom-border = <0>;
		qcom,mdss-dsi-bpp = <24>;
		qcom,mdss-dsi-color-order = "rgb_swap_rgb";
		qcom,mdss-dsi-underflow-color = <0xff>;
		qcom,mdss-dsi-border-color = <0>;
		qcom,mdss-dsi-h-sync-pulse = <0>;
		qcom,mdss-dsi-traffic-mode = "burst_mode";
		qcom,mdss-dsi-lane-map = "lane_map_0123";
		qcom,mdss-dsi-bllp-eof-power-mode;
		qcom,mdss-dsi-bllp-power-mode;
		qcom,mdss-dsi-tx-eot-append;
		qcom,mdss-dsi-lane-0-state;
		qcom,mdss-dsi-lane-1-state;
		qcom,mdss-dsi-lane-2-state;
		qcom,mdss-dsi-lane-3-state;
		qcom,mdss-dsi-dma-trigger = "trigger_sw";
		qcom,mdss-dsi-mdp-trigger = "none";
		qcom,mdss-dsi-lp11-init;
		qcom,mdss-dsi-bl-pmic-control-type = "bl_ctrl_dcs";
		qcom,bl-update-flag = "delay_until_first_frame";
		qcom,mdss-dsi-bl-min-level = <1>;
		qcom,mdss-dsi-bl-max-level = <4095>;
		qcom,mdss-dsi-reset-sequence = <1 10 0 5 1 2>;
		qcom,mdss-pan-physical-width-dimension = <143>;
		qcom,mdss-pan-physical-height-dimension = <235>;
		qcom,mdss-dsi-panel-orientation = "180";
		qcom,esd-check-enabled;
		qcom,mdss-dsi-panel-status-command = [06 01 00 01 05 00 01 0a];
		qcom,mdss-dsi-panel-status-command-mode = "dsi_lp_mode";
		qcom,mdss-dsi-panel-status-check-mode = "reg_read";
		qcom,mdss-dsi-panel-status-read-length = <1 1 1>;
		qcom,mdss-dsi-panel-status-valid-params = <1 1 1>;
		qcom,mdss-dsi-panel-status-value = <156>;
		qcom,mdss-dsi-panel-max-error-count = <3>;
		qcom,mdss-dsi-t-clk-post = <14>;
		qcom,mdss-dsi-t-clk-pre = <53>;
		qcom,dsi-select-clocks = "mux_byte_clk0", "mux_pixel_clk0", "src_byte_clk0", "src_pixel_clk0", "shadow_byte_clk0", "shadow_pixel_clk0";
		qcom,platform-reset-gpio-always-on;
		qcom,platform-reset-gpio = <&tlmm 82 0>;

		qcom,mdss-dsi-display-timings {
			timing@0 {
				qcom,default-topology-index = <0>;
				qcom,display-topology = <1 0 1>;
				qcom,mdss-dsi-panel-width = <1200>;
				qcom,mdss-dsi-panel-height = <2000>;
				qcom,mdss-dsi-h-front-porch = <58>;
				qcom,mdss-dsi-h-back-porch = <60>;
				qcom,mdss-dsi-h-pulse-width = <2>;
				qcom,mdss-dsi-h-sync-skew = <0>;
				qcom,mdss-dsi-v-back-porch = <93>;
				qcom,mdss-dsi-v-front-porch = <26>;
				qcom,mdss-dsi-v-pulse-width = <2>;
				qcom,mdss-dsi-panel-framerate = <60>;
				qcom,mdss-dsi-panel-phy-timings = [
					25 20 09 0a 06 02 04 a0 25
					20 09 0a 06 02 04 a0 25 20
					09 0a 06 02 04 a0 25 20 09
					0a 06 02 04 a0 25 1f 08 0a
					06 02 04 a0];
				qcom,mdss-dsi-on-command = [
					15 01 00 00 00 00 02 ff 20
					15 01 00 00 00 00 02 fb 01
					15 01 00 00 00 00 02 05 d9
					15 01 00 00 00 00 02 07 78
					15 01 00 00 00 00 02 08 5a
					15 01 00 00 00 00 02 0d 63
					15 01 00 00 00 00 02 0e 91
					15 01 00 00 00 00 02 0f 73
					15 01 00 00 00 00 02 95 eb
					15 01 00 00 00 00 02 96 eb
					15 01 00 00 00 00 02 30 11
					15 01 00 00 00 00 02 6d 66
					15 01 00 00 00 00 02 75 a2
					15 01 00 00 00 00 02 77 b3
					39 01 00 00 00 00 11 b0 00
					08 00 23 00 4d 00 6d 00 89
					00 a1 00 b6 00 c9 39 01 00
					00 00 00 11 b1 00 da 01 13
					01 3c 01 7e 01 ab 01 f7 02
					2f 02 31 39 01 00 00 00 00
					11 b2 02 67 02 a6 02 d1 03
					08 03 2e 03 5b 03 6b 03 7b
					39 01 00 00 00 00 0d b3 03
					8e 03 a2 03 b7 03 e7 03 fd
					03 ff 39 01 00 00 00 00 11
					b4 00 08 00 23 00 4d 00 6d
					00 89 00 a1 00 b6 00 c9 39
					01 00 00 00 00 11 b5 00 da
					01 13 01 3c 01 7e 01 ab 01
					f7 02 2f 02 31 39 01 00 00
					00 00 11 b6 02 67 02 a6 02
					d1 03 08 03 2e 03 5b 03 6b
					03 7b 39 01 00 00 00 00 0d
					b7 03 8e 03 a2 03 b7 03 e7
					03 fd 03 ff 39 01 00 00 00
					00 11 b8 00 08 00 23 00 4d
					00 6d 00 89 00 a1 00 b6 00
					c9 39 01 00 00 00 00 11 b9
					00 da 01 13 01 3c 01 7e 01
					ab 01 f7 02 2f 02 31 39 01
					00 00 00 00 11 ba 02 67 02
					a6 02 d1 03 08 03 2e 03 5b
					03 6b 03 7b 39 01 00 00 00
					00 0d bb 03 8e 03 a2 03 b7
					03 e7 03 fd 03 ff 15 01 00
					00 00 00 02 ff 21 15 01 00
					00 00 00 02 fb 01 39 01 00
					00 00 00 11 b0 00 00 00 1b
					00 45 00 65 00 81 00 99 00
					ae 00 c1 39 01 00 00 00 00
					11 b1 00 d2 01 0b 01 34 01
					76 01 a3 01 ef 02 27 02 29
					39 01 00 00 00 00 11 b2 02
					5f 02 9e 02 c9 03 00 03 26
					03 53 03 63 03 73 39 01 00
					00 00 00 0d b3 03 86 03 9a
					03 af 03 df 03 f5 03 f7 39
					01 00 00 00 00 11 b4 00 00
					00 1b 00 45 00 65 00 81 00
					99 00 ae 00 c1 39 01 00 00
					00 00 11 b5 00 d2 01 0b 01
					34 01 76 01 a3 01 ef 02 27
					02 29 39 01 00 00 00 00 11
					b6 02 5f 02 9e 02 c9 03 00
					03 26 03 53 03 63 03 73 39
					01 00 00 00 00 0d b7 03 86
					03 9a 03 af 03 df 03 f5 03
					f7 39 01 00 00 00 00 11 b8
					00 00 00 1b 00 45 00 65 00
					81 00 99 00 ae 00 c1 39 01
					00 00 00 00 11 b9 00 d2 01
					0b 01 34 01 76 01 a3 01 ef
					02 27 02 29 39 01 00 00 00
					00 11 ba 02 5f 02 9e 02 c9
					03 00 03 26 03 53 03 63 03
					73 39 01 00 00 00 00 0d bb
					03 86 03 9a 03 af 03 df 03
					f5 03 f7 15 01 00 00 00 00
					02 ff 23 15 01 00 00 00 00
					02 fb 01 15 01 00 00 00 00
					02 00 80 15 01 00 00 00 00
					02 07 00 15 01 00 00 00 00
					02 11 01 15 01 00 00 00 00
					02 12 77 15 01 00 00 00 00
					02 15 07 15 01 00 00 00 00
					02 16 07 15 01 00 00 00 00
					02 ff 24 15 01 00 00 00 00
					02 fb 01 15 01 00 00 00 00
					02 00 00 15 01 00 00 00 00
					02 01 00 15 01 00 00 00 00
					02 02 1c 15 01 00 00 00 00
					02 03 1c 15 01 00 00 00 00
					02 04 1d 15 01 00 00 00 00
					02 05 1d 15 01 00 00 00 00
					02 06 04 15 01 00 00 00 00
					02 07 04 15 01 00 00 00 00
					02 08 0f 15 01 00 00 00 00
					02 09 0f 15 01 00 00 00 00
					02 0a 0e 15 01 00 00 00 00
					02 0b 0e 15 01 00 00 00 00
					02 0c 0d 15 01 00 00 00 00
					02 0d 0d 15 01 00 00 00 00
					02 0e 0c 15 01 00 00 00 00
					02 0f 0c 15 01 00 00 00 00
					02 10 08 15 01 00 00 00 00
					02 11 08 15 01 00 00 00 00
					02 12 00 15 01 00 00 00 00
					02 13 00 15 01 00 00 00 00
					02 14 00 15 01 00 00 00 00
					02 15 00 15 01 00 00 00 00
					02 16 00 15 01 00 00 00 00
					02 17 00 15 01 00 00 00 00
					02 18 1c 15 01 00 00 00 00
					02 19 1c 15 01 00 00 00 00
					02 1a 1d 15 01 00 00 00 00
					02 1b 1d 15 01 00 00 00 00
					02 1c 04 15 01 00 00 00 00
					02 1d 04 15 01 00 00 00 00
					02 1e 0f 15 01 00 00 00 00
					02 1f 0f 15 01 00 00 00 00
					02 20 0e 15 01 00 00 00 00
					02 21 0e 15 01 00 00 00 00
					02 22 0d 15 01 00 00 00 00
					02 23 0d 15 01 00 00 00 00
					02 24 0c 15 01 00 00 00 00
					02 25 0c 15 01 00 00 00 00
					02 26 08 15 01 00 00 00 00
					02 27 08 15 01 00 00 00 00
					02 28 00 15 01 00 00 00 00
					02 29 00 15 01 00 00 00 00
					02 2a 00 15 01 00 00 00 00
					02 2b 00 15 01 00 00 00 00
					02 2d 20 15 01 00 00 00 00
					02 2f 0a 15 01 00 00 00 00
					02 30 44 15 01 00 00 00 00
					02 33 0c 15 01 00 00 00 00
					02 34 32 15 01 00 00 00 00
					02 37 44 15 01 00 00 00 00
					02 38 40 15 01 00 00 00 00
					02 39 00 15 01 00 00 00 00
					02 3a 9a 15 01 00 00 00 00
					02 3b a0 15 01 00 00 00 00
					02 3d 42 15 01 00 00 00 00
					02 3f 06 15 01 00 00 00 00
					02 43 06 15 01 00 00 00 00
					02 47 66 15 01 00 00 00 00
					02 4a 9a 15 01 00 00 00 00
					02 4b a0 15 01 00 00 00 00
					02 4c 91 15 01 00 00 00 00
					02 4d 21 15 01 00 00 00 00
					02 4e 43 15 01 00 00 00 00
					02 51 12 15 01 00 00 00 00
					02 52 34 39 01 00 00 00 00
					03 55 82 02 15 01 00 00 00
					00 02 56 04 15 01 00 00 00
					00 02 58 21 15 01 00 00 00
					00 02 59 30 15 01 00 00 00
					00 02 5a ba 15 01 00 00 00
					00 02 5b a0 39 01 00 00 00
					00 03 5e 00 06 15 01 00 00
					00 00 02 5f 00 15 01 00 00
					00 00 02 65 82 15 01 00 00
					00 00 02 7e 20 15 01 00 00
					00 00 02 7f 3c 15 01 00 00
					00 00 02 82 04 15 01 00 00
					00 00 02 97 c0 39 01 00 00
					00 00 0d b6 05 00 05 00 00
					00 00 00 05 05 00 00 15 01
					00 00 00 00 02 92 c4 15 01
					00 00 00 00 02 93 1a 15 01
					00 00 00 00 02 94 5f 15 01
					00 00 00 00 02 d7 55 15 01
					00 00 00 00 02 da 0a 15 01
					00 00 00 00 02 de 08 15 01
					00 00 00 00 02 db 05 15 01
					00 00 00 00 02 dc c4 15 01
					00 00 00 00 02 dd 22 15 01
					00 00 00 00 02 df 05 15 01
					00 00 00 00 02 e0 c4 15 01
					00 00 00 00 02 e1 05 15 01
					00 00 00 00 02 e2 c4 15 01
					00 00 00 00 02 e3 05 15 01
					00 00 00 00 02 e4 c4 15 01
					00 00 00 00 02 e5 05 15 01
					00 00 00 00 02 e6 c4 15 01
					00 00 00 00 02 5c 88 15 01
					00 00 00 00 02 5d 08 15 01
					00 00 00 00 02 8d 88 15 01
					00 00 00 00 02 8e 08 15 01
					00 00 00 00 02 b5 90 15 01
					00 00 00 00 02 ff 25 15 01
					00 00 00 00 02 fb 01 15 01
					00 00 00 00 02 05 00 15 01
					00 00 00 00 02 19 07 15 01
					00 00 00 00 02 1f ba 15 01
					00 00 00 00 02 20 a0 15 01
					00 00 00 00 02 26 ba 15 01
					00 00 00 00 02 27 a0 15 01
					00 00 00 00 02 33 ba 15 01
					00 00 00 00 02 34 a0 15 01
					00 00 00 00 02 3f e0 15 01
					00 00 00 00 02 40 00 15 01
					00 00 00 00 02 44 00 15 01
					00 00 00 00 02 45 40 15 01
					00 00 00 00 02 48 ba 15 01
					00 00 00 00 02 49 a0 15 01
					00 00 00 00 02 5b 00 15 01
					00 00 00 00 02 5c 00 15 01
					00 00 00 00 02 5d 00 15 01
					00 00 00 00 02 5e d0 15 01
					00 00 00 00 02 61 ba 15 01
					00 00 00 00 02 62 a0 15 01
					00 00 00 00 02 f1 10 15 01
					00 00 00 00 02 ff 2a 15 01
					00 00 00 00 02 fb 01 15 01
					00 00 00 00 02 64 16 15 01
					00 00 00 00 02 67 16 15 01
					00 00 00 00 02 6a 16 15 01
					00 00 00 00 02 70 30 15 01
					00 00 00 00 02 a2 f3 15 01
					00 00 00 00 02 a3 ff 15 01
					00 00 00 00 02 a4 ff 15 01
					00 00 00 00 02 a5 ff 15 01
					00 00 00 00 02 d6 08 15 01
					00 00 00 00 02 ff 26 15 01
					00 00 00 00 02 fb 01 15 01
					00 00 00 00 02 00 a1 15 01
					00 00 00 00 02 0a f2 15 01
					00 00 00 00 02 04 28 15 01
					00 00 00 00 02 06 30 15 01
					00 00 00 00 02 0c 13 15 01
					00 00 00 00 02 0d 0a 15 01
					00 00 00 00 02 0f 0a 15 01
					00 00 00 00 02 11 00 15 01
					00 00 00 00 02 12 50 15 01
					00 00 00 00 02 13 51 15 01
					00 00 00 00 02 14 65 15 01
					00 00 00 00 02 15 00 15 01
					00 00 00 00 02 16 10 15 01
					00 00 00 00 02 17 a0 15 01
					00 00 00 00 02 18 86 15 01
					00 00 00 00 02 19 11 15 01
					00 00 00 00 02 1a 7b 15 01
					00 00 00 00 02 1b 10 15 01
					00 00 00 00 02 1c bb 15 01
					00 00 00 00 02 22 00 15 01
					00 00 00 00 02 23 00 15 01
					00 00 00 00 02 2a 11 15 01
					00 00 00 00 02 2b 7b 15 01
					00 00 00 00 02 1d 00 15 01
					00 00 00 00 02 1e c3 15 01
					00 00 00 00 02 1f c3 15 01
					00 00 00 00 02 24 00 15 01
					00 00 00 00 02 25 c3 15 01
					00 00 00 00 02 2f 05 15 01
					00 00 00 00 02 30 c3 15 01
					00 00 00 00 02 31 00 15 01
					00 00 00 00 02 32 c3 15 01
					00 00 00 00 02 39 00 15 01
					00 00 00 00 02 3a c3 15 01
					00 00 00 00 02 20 01 15 01
					00 00 00 00 02 33 11 15 01
					00 00 00 00 02 34 78 15 01
					00 00 00 00 02 35 16 15 01
					00 00 00 00 02 c8 04 15 01
					00 00 00 00 02 c9 82 15 01
					00 00 00 00 02 ca 4e 15 01
					00 00 00 00 02 cb 00 15 01
					00 00 00 00 02 a9 4c 15 01
					00 00 00 00 02 aa 47 15 01
					00 00 00 00 02 ff 27 15 01
					00 00 00 00 02 fb 01 15 01
					00 00 00 00 02 56 06 15 01
					00 00 00 00 02 58 80 15 01
					00 00 00 00 02 59 53 15 01
					00 00 00 00 02 5a 00 15 01
					00 00 00 00 02 5b 14 15 01
					00 00 00 00 02 5c 00 15 01
					00 00 00 00 02 5d 01 15 01
					00 00 00 00 02 5e 20 15 01
					00 00 00 00 02 5f 10 15 01
					00 00 00 00 02 60 00 15 01
					00 00 00 00 02 61 1d 15 01
					00 00 00 00 02 62 00 15 01
					00 00 00 00 02 63 01 15 01
					00 00 00 00 02 64 24 15 01
					00 00 00 00 02 65 1c 15 01
					00 00 00 00 02 66 00 15 01
					00 00 00 00 02 67 01 15 01
					00 00 00 00 02 68 25 15 01
					00 00 00 00 02 00 00 15 01
					00 00 00 00 02 78 00 15 01
					00 00 00 00 02 c3 00 15 01
					00 00 00 00 02 d1 24 15 01
					00 00 00 00 02 d2 30 15 01
					00 00 00 00 02 ff 2a 15 01
					00 00 00 00 02 fb 01 15 01
					00 00 00 00 02 22 2f 15 01
					00 00 00 00 02 23 08 15 01
					00 00 00 00 02 24 00 15 01
					00 00 00 00 02 25 c3 15 01
					00 00 00 00 02 26 f8 15 01
					00 00 00 00 02 27 00 15 01
					00 00 00 00 02 28 1a 15 01
					00 00 00 00 02 29 00 15 01
					00 00 00 00 02 2a 1a 15 01
					00 00 00 00 02 2b 00 15 01
					00 00 00 00 02 2d 1a 15 01
					00 00 00 00 02 ff e0 15 01
					00 00 00 00 02 fb 01 15 01
					00 00 00 00 02 14 60 15 01
					00 00 00 00 02 16 c0 15 01
					00 00 00 00 02 ff f0 15 01
					00 00 00 00 02 fb 01 15 01
					00 00 00 00 02 3a 08 15 01
					00 00 00 00 02 ff 24 15 01
					00 00 00 00 02 fb 01 15 01
					00 00 00 00 02 3a 5d 15 01
					00 00 00 00 02 3b 60 15 01
					00 00 00 00 02 4a 5d 15 01
					00 00 00 00 02 4b 60 15 01
					00 00 00 00 02 5a 70 15 01
					00 00 00 00 02 5b 60 15 01
					00 00 00 00 02 91 44 15 01
					00 00 00 00 02 92 75 15 01
					00 00 00 00 02 db 05 15 01
					00 00 00 00 02 dc 75 15 01
					00 00 00 00 02 dd 22 15 01
					00 00 00 00 02 df 05 15 01
					00 00 00 00 02 e0 75 15 01
					00 00 00 00 02 e1 05 15 01
					00 00 00 00 02 e2 75 15 01
					00 00 00 00 02 e3 05 15 01
					00 00 00 00 02 e4 75 15 01
					00 00 00 00 02 e5 05 15 01
					00 00 00 00 02 e6 75 15 01
					00 00 00 00 02 5c 00 15 01
					00 00 00 00 02 5d 00 15 01
					00 00 00 00 02 8d 00 15 01
					00 00 00 00 02 8e 00 15 01
					00 00 00 00 02 ff 25 15 01
					00 00 00 00 02 fb 01 15 01
					00 00 00 00 02 1f 70 15 01
					00 00 00 00 02 20 60 15 01
					00 00 00 00 02 26 70 15 01
					00 00 00 00 02 27 60 15 01
					00 00 00 00 02 33 70 15 01
					00 00 00 00 02 34 60 15 01
					00 00 00 00 02 48 70 15 01
					00 00 00 00 02 49 60 15 01
					00 00 00 00 02 5b 00 15 01
					00 00 00 00 02 61 70 15 01
					00 00 00 00 02 62 60 15 01
					00 00 00 00 02 ff 26 15 01
					00 00 00 00 02 fb 01 15 01
					00 00 00 00 02 02 31 15 01
					00 00 00 00 02 19 0a 15 01
					00 00 00 00 02 1a 7f 15 01
					00 00 00 00 02 1b 0a 15 01
					00 00 00 00 02 1c 0c 15 01
					00 00 00 00 02 2a 0a 15 01
					00 00 00 00 02 2b 7f 15 01
					00 00 00 00 02 1e 75 15 01
					00 00 00 00 02 1f 75 15 01
					00 00 00 00 02 25 75 15 01
					00 00 00 00 02 30 75 15 01
					00 00 00 00 02 31 05 15 01
					00 00 00 00 02 32 8d 15 01
					00 00 00 00 02 3a 75 15 01
					00 00 00 00 02 ff 2a 15 01
					00 00 00 00 02 fb 01 15 01
					00 00 00 00 02 25 75 15 01
					00 00 00 00 02 ff 10 15 01
					00 00 00 00 02 fb 01 15 01
					00 00 00 00 02 b9 01 15 01
					00 00 00 00 02 ff 20 15 01
					00 00 00 00 02 fb 01 15 01
					00 00 00 00 02 18 40 15 01
					00 00 00 00 02 ff 10 15 01
					00 00 00 00 02 fb 01 15 01
					00 00 00 00 02 b9 02 15 01
					00 00 00 00 02 35 00 15 01
					00 00 00 00 02 bb 13 39 01
					00 00 00 00 06 3b 03 5f 1a
					04 04 15 01 00 00 0a 00 02
					ff 10 15 01 00 00 00 00 02
					fb 01 39 01 00 00 00 00 03
					51 00 00 15 01 00 00 00 00
					02 53 2c 15 01 00 00 00 00
					02 55 00 39 01 00 00 00 00
					03 68 05 01 05 01 00 00 64
					00 02 11 00 05 01 00 00 1e
					00 02 29 00];
				qcom,mdss-dsi-off-command = [
					05 01 00 00 00 00 02 28 00
					05 01 00 00 50 00 02 10 00];
				qcom,mdss-dsi-on-command-state = "dsi_lp_mode";
				qcom,mdss-dsi-off-command-state = "dsi_lp_mode";
			};
		};
	};
};
