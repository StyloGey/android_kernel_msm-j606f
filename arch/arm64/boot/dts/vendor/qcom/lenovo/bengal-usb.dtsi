&qusb_phy0 {
	qcom,qusb-phy-init-seq = <0xf8 0x80
			0x73 0x84
			0x93 0x88
			0xc7 0x8c
			0x11 0x90
			0x30 0x08
			0x79 0x0c
			0x21 0x10
			0x14 0x9c
			0x80 0x04
			0x9f 0x1c
			0x00 0x18>;
};

&usb0 {
	extcon = <&dock_extcon>, <&eud>;
};

&soc {
	usb_int {
		compatible = "qcom,usb_int";
		interrupt-parent = <&tlmm>;
		interrupts = <66 IRQ_TYPE_NONE>;
	};
};
