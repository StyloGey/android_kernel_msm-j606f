&dai_mi2s0 {
	qcom,msm-mi2s-rx-lines = <1>;
	qcom,msm-mi2s-tx-lines = <2>;
};

&dai_mi2s1 {
	qcom,msm-mi2s-tx-lines = <2>;
};

&tdm_pri_rx {
	qcom,msm-cpudai-tdm-sync-mode = <0>;
	qcom,msm-cpudai-tdm-data-delay = <0>;
};

&tdm_pri_tx {
	qcom,msm-cpudai-tdm-sync-mode = <0>;
	qcom,msm-cpudai-tdm-data-delay = <0>;
};

