## drivers/lenovo/Kconfig
```kconfig
config LENOVO
	bool "Lenovo drivers"
	default n

if LENOVO

source "drivers/lenovo/input/Kconfig"

source "drivers/lenovo/power/Kconfig"

source "drivers/lenovo/usb/Kconfig"

source "drivers/lenovo/video/Kconfig"

endif
```

## drivers/lenovo/input/Kconfig
```kconfig
if INPUT

config INPUT_HALL_SENSOR
	tristate "hall sensor driver"

source "drivers/lenovo/input/touchscreen/Kconfig"

endif
```

## drivers/lenovo/input/touchscreen/Kconfig
```kconfig
if INPUT_TOUCHSCREEN

config TOUCHSCREEN_HIMAX_CHIPSET
	bool "Himax touchpanel CHIPSET"
	depends on SPI
	help
	  Say Y here if you have a Himax CHIPSET touchscreen.
	  HIMAX controllers are multi touch controllers which can
	  report 10 touches at a time.

	  If unsure, say N.

if TOUCHSCREEN_HIMAX_CHIPSET

source "drivers/lenovo/input/touchscreen/himax83102p/Kconfig"

endif

config VITURALSAR
	bool "Vitural Sar series"
	depends on I2C

endif
```

## drivers/lenovo/power/supply/qcom/Kconfig
```kconfig
config MM8013_FG
	bool "Enble MM8013 FG driver"
	help
	  Say Y here to enable the Fuel Gauge driver.

config POGO
	bool "Enble POGO driver"
	help
	  Say Y here to enable the POGO driver.
```

## drivers/lenovo/usb/Kconfig
```kconfig
if USB_SUPPORT

source "drivers/lenovo/usb/fusb302b/Kconfig"

source "drivers/lenovo/usb/typec/Kconfig"

endif
```

## drivers/lenovo/usb/fusb302b/Kconfig
```kconfig
config FUSB_30X
	tristate "Fairchild FUSB30X Type-C chip driver"
	depends on I2C
	help
	  This is a driver for the Fairchild FUSB302 Type-C chip.
```

## drivers/lenovo/video/backlight/Kconfig
```kconfig
if BACKLIGHT_LCD_SUPPORT

if BACKLIGHT_CLASS_DEVICE

config LCD_BIAS_TPS65132
	bool "Enble TPS65132 driver"
	help
	  define tps65132 driver config to enable tps65132 driver.
	  To set tps65132 driver which you choose avoid cannot driver OCP2131.
	  Please make sure CONFIG_MTK_LCM_BIAS_TPS65132 in xxxxxx_defconfig.mk.
	  And also make sure true on in ProjectConfig.mk

config BACKLIGHT_SGM37604
	bool "Enble SGM37604A driver"
	help
	  define SGM37604A driver config to enable SGM37604A driver.
	  To set SGM37604A driver which you choose avoid cannot driver SGM37604A.
	  Please make sure CONFIG_MTK_LCM_BACKLIGHT_SGM37604A in xxxxxx_defconfig.mk.
	  And also make sure true on in ProjectConfig.mk

endif

endif
```
